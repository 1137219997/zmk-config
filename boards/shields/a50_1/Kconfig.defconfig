## boards/shields/a50_1/Kconfig.defconfig
```kconfig
# SPDX-License-Identifier: MIT

if SHIELD_A50_1

config ZMK_KEYBOARD_NAME
    default "A50-1"

endif
```

## boards/shields/a50_1/Kconfig.shield
```kconfig
# SPDX-License-Identifier: MIT

config SHIELD_A50_1
    def_bool $(shields_list_contains,a50_1)
```
